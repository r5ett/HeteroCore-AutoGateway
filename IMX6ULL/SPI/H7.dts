h7_gateway@0 {
        compatible = "mydev,h7-gateway";
        reg = <0>;                       
        spi-max-frequency = <50000000>;
        
        interrupt-parent = <&gpio4>;
        interrupts = <19 IRQ_TYPE_EDGE_FALLING>;
    };