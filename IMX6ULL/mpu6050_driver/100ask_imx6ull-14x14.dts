&i2c1 {
    clock-frequency = <100000>;
    pinctrl-names = "default";
    pinctrl-0 = <&pinctrl_i2c1>;
    status = "okay";

    /* 新增 MPU6050 节点 */
    my_mpu6050@68 {
        compatible = "r5ett,mpu6050"; /* 记住这个名字，后面写驱动要用 */
        reg = <0x68>;                  /* 刚才扫出来的 I2C 地址 */
    };
    
};